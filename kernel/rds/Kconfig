## kernel/rds/Kconfig
```kconfig
#
# RINA Data Structures configuration
#
# Written by Francesco Salvestrini <f.salvestrini@nextworks.it>
#

config RINA_MEMORY_STATS
	bool "Memory allocation/deallocation stats"
	default n
        depends on RINA_DEBUG
	help
	  No help for the time being

config RINA_MEMORY_STATS_INTERVAL
        depends on RINA_MEMORY_STATS
	int "Rate limit mem-stat dumps (in msecs)"
        default 2000
        help
          No help for the time being

config RINA_MEMORY_DEBUG
	bool "Memory allocation/deallocation extra checks"
	default y
        depends on RINA_DEBUG
	help
	  No help for the time being

config RINA_MEMORY_TAMPERING
	bool "Memory blocks tampering"
	default n
        depends on RINA_MEMORY_DEBUG
	help
	  No help for the time being

config RINA_MEMORY_TAMPERING_VERBOSE
	bool "Memory blocks tampering verbose bloatings"
	default n
        depends on RINA_MEMORY_TAMPERING
	help
	  No help for the time being

config RINA_MEMORY_POISONING
	bool "Memory blocks poisoning"
	default n
        depends on RINA_MEMORY_DEBUG
	help
	  No help for the time being

config RINA_MEMORY_POISONING_VERBOSE
	bool "Memory blocks poisoning verbose bloatings"
	default n
        depends on RINA_MEMORY_POISONING
	help
	  No help for the time being

config RINA_MEMORY_PTRS_DUMP
	bool "Dump pointers passed to alloc()/returned by free()"
	default n
        depends on RINA_MEMORY_DEBUG
	help
	  No help for the time being

menu "Regression testing"

config RINA_RDS_REGRESSION_TESTS
	bool "RDS regression tests"
	default n
        depends on RINA_REGRESSION_TESTS
	help
	  No help for the time being

config RINA_RTIMER_REGRESSION_TESTS
	bool "RTimer regression tests"
	default n
        depends on RINA_RDS_REGRESSION_TESTS
	help
	  No help for the time being

config RINA_RQUEUE_REGRESSION_TESTS
	bool "RQUEUE regression tests"
	default n
        depends on RINA_RDS_REGRESSION_TESTS
	help
	  No help for the time being

config RINA_RFIFO_REGRESSION_TESTS
	bool "RFIFO regression tests"
	default n
        depends on RINA_RDS_REGRESSION_TESTS
	help
	  No help for the time being

config RINA_RMEM_REGRESSION_TESTS
	bool "RMEM regression tests"
	default n
        depends on RINA_RDS_REGRESSION_TESTS
	help
	  No help for the time being

config RINA_RINGQ_REGRESSION_TESTS
	bool "RINGQ regression tests"
	default n
	depends on RINA_RDS_REGRESSION_TESTS
	help
	  No help for the time being

endmenu
```

## linux/net/rina/Kconfig
```kconfig
#
# RINA core configuration
#
# Written by Francesco Salvestrini <f.salvestrini@nextworks.it>
#

menuconfig RINA
	bool "RINA support"
        depends on NET && SYSFS
	default y
	---help---
	  No help for the time being

if RINA

menuconfig RINA_DEBUG
	bool "Debugging support"
	default y
	help
	  No help for the time being

if RINA_DEBUG

config RINA_SYSCALLS_DEBUG
        bool "Debug RINA syscalls"
        default n
        help
          no help for the time being

config RINA_KIPCM_LOCKS_DEBUG
	bool "K-IPC Manager locks debugging"
	default n
	help
	  No help for the time being

config RINA_DEBUG_HEARTBEATS
	bool "Dump heartbeat messages"
	default y
	help
	  No help for the time being

config RINA_ASSERTIONS
	bool "Embed assertions (slowing down everything)"
	default y
	help
	  No help for the time being

config RINA_SUPPRESS_DEBUG_LOGS
	bool "Remove code related to debugging logs"
	default n
	help
	  No help for the time being

config RINA_REGRESSION_TESTS
	bool "Enable regression testing suites"
	default n
	help
	  No help for the time being

endif

menu "Core"

source "net/rina/rds/Kconfig"

endmenu

menuconfig IPC_PROCESSES
	bool "IPC Processes"
        default y

if IPC_PROCESSES
source "net/rina/ipcps/Kconfig"
source "net/rina/rinarp/Kconfig"
source "net/rina/vmpi/Kconfig"

endif

endif
```

## linux/net/rina/ipcps/Kconfig
```kconfig
#
# RINA IPCPs configuration
#
# Written by Francesco Salvestrini <f.salvestrini@nextworks.it>
#

config RINA_NORMAL_IPCP
	tristate "Normal IPC Process"
	default y
	help
	  No help for the time being

if RINA_NORMAL_IPCP

menu "DTCP"
choice RINA_DTCP_RCVR_ACK
       prompt "Received ACK policy"
       default RINA_DTCP_RCVR_ACK

config RINA_DTCP_RCVR_ACK
       bool "Use rcvr-ack"

config RINA_DTCP_RCVR_ACK_ATIMER
       bool "Use to rcvr-ack ATIMER"
endchoice
endmenu

endif

config RINA_SHIM_ETH_VLAN
	tristate "Shim IPC over Ethernet (using VLANs) support"
	default m
        depends on RINARP
	help
	  No help for the time being

config RINA_SHIM_ETH_VLAN_BURST_LIMITING
	bool "Ethernet burst limiting"
	default n
        depends on RINA_SHIM_ETH_VLAN
        help
	  No help for the time being

config RINA_SHIM_ETH_VLAN_BURST_LIMIT
       depends on RINA_SHIM_ETH_VLAN_BURST_LIMITING
       int "Receiver burst limit frames count"
       default 50
       help
         No help for the time being

config RINA_SHIM_ETH_VLAN_REGRESSION_TESTS
	bool "Perform regression testing upon loading"
	default n
        depends on RINA_SHIM_ETH_VLAN
	help
	  No help for the time being

config RINA_SHIM_TCP_UDP
	tristate "Shim IPC over TCP/UDP support"
	default m
	help
	  No help for the time being

config RINA_SHIM_TCP_UDP_BUFFER_SIZE
        int "Buffer size"
	default 1500
        range 2 65535
        depends on RINA_SHIM_TCP_UDP
	help
	  No help for the time being

config RINA_SHIM_HV
	tristate "Shim IPC for Hypervisors"
	default m
        depends on (VMPI_KVM_GUEST || VMPI_KVM_HOST || \
                   VMPI_XEN_GUEST || VMPI_XEN_HOST)
	help
	  No help for the time being
```

## linux/net/rina/rds/Kconfig
```kconfig
#
# RINA Data Structures configuration
#
# Written by Francesco Salvestrini <f.salvestrini@nextworks.it>
#

config RINA_MEMORY_CHECKS
	bool "Memory allocation/deallocation extra checks"
	default y
        depends on RINA_DEBUG
	help
	  No help for the time being

config RINA_MEMORY_TAMPERING
	bool "Memory blocks tampering"
	default n
        depends on RINA_MEMORY_CHECKS
	help
	  No help for the time being

config RINA_MEMORY_TAMPERING_VERBOSE
	bool "Memory blocks tampering verbose bloatings"
	default n
        depends on RINA_MEMORY_TAMPERING
	help
	  No help for the time being

config RINA_MEMORY_POISONING
	bool "Memory blocks poisoning"
	default n
        depends on RINA_MEMORY_CHECKS
	help
	  No help for the time being

config RINA_MEMORY_POISONING_VERBOSE
	bool "Memory blocks poisoning verbose bloatings"
	default n
        depends on RINA_MEMORY_POISONING
	help
	  No help for the time being

config RINA_MEMORY_PTRS_DUMP
	bool "Dump pointers passed to alloc()/returned by free()"
	default n
        depends on RINA_MEMORY_CHECKS
	help
	  No help for the time being
```

## linux/net/rina/rinarp/Kconfig
```kconfig
#
# RINA ARP configuration
#
# Written by Francesco Salvestrini <f.salvestrini@nextworks.it>
#

config ARP826
	tristate "RFC-826 ARP compliant implementation"
	default m
	help
	  No help for the time being

config ARP826_REGRESSION_TESTS
	bool "Perform regression testing upon loading"
	default n
        depends on ARP826
	help
	  No help for the time being

config RINARP
	tristate "RINA ARP implementation"
	default m
        depends on ARP826
	help
	  No help for the time being
```

## linux/net/rina/vmpi/Kconfig
```kconfig
#
# VMPI
#
# Written by Francesco Salvestrini <f.salvestrini@nextworks.it>
#

menuconfig VMPI
	bool "VMPI support"
        default n

if VMPI

config VMPI_KVM_GUEST
	tristate "VMPI for KVM and Virtio - guest support"
	default m
        depends on VIRTIO
	help
	  No help for the time being

config VMPI_KVM_HOST
	tristate "VMPI for KVM and Virtio - host support"
	default m
        depends on VHOST
	help
	  No help for the time being

config VMPI_XEN_GUEST
        tristate "VMPI for Xen - guest support"
        default m
        depends on XEN
        help
	  No help for the time being

config VMPI_XEN_HOST
        tristate "VMPI for Xen - host support"
        default m
        depends on XEN
        help
          No help for the time being

endif
```

## net/rina/Kconfig
```kconfig
#
# RINA configuration
#

menuconfig RINA
	bool "RINA support"
        depends on NET
	default y
	---help---
	  No help for the time being

if RINA

config RINA_SYSFS
	bool "SysFS support"
        depends on SYSFS
	default y
	help
	  No help for the time being

config RINA_DEBUG
	bool "Debugging support"
	default y
	help
	  No help for the time being

config RINA_UNFILTERED_LOGS
	bool "Unfiltered logging"
	default y
	depends on RINA_DEBUG
	help
	  No help for the time being

config RINA_DEBUG_SCOPES
	bool "Dump a message upon entering/exiting a scope"
	default y
	depends on RINA_DEBUG
	help
	  No help for the time being

config RINA_DEBUG_HEARTBEATS
	bool "Dump heartbeat messages"
	default y
	depends on RINA_DEBUG
	help
	  No help for the time being

config RINA_ASSERTIONS
	bool "Embedded assertions"
	default y
	depends on RINA_DEBUG
	help
	  No help for the time being

config RINA_PERSONALITY_DEFAULT
       	tristate "Default Personality support"
	default y
	---help---
	  No help for the time being

config RINA_SHIM_DUMMY
	tristate "Dummy Shim IPC"
	default y
        depends on RINA_PERSONALITY_DEFAULT && RINA_DEBUG
	help
	  No help for the time being

config RINA_SHIM_ETH
	tristate "Shim IPC over Ethernet support"
	default y
        depends on RINA_PERSONALITY_DEFAULT
	help
	  No help for the time being

config RINA_SHIM_TCP_UDP
	tristate "Shim IPC over TCP/UDP support"
	default y
        depends on RINA_PERSONALITY_DEFAULT
	help
	  No help for the time being

endif
```
